/*
 * Copyright (c) 2020 Pete Johanson
 *
 * SPDX-License-Identifier: MIT
 */

#include "corne.dtsi"

&kscan0 {
    col-gpios
        = <&pro_micro 21 GPIO_ACTIVE_HIGH> //extra
        , <&pro_micro 10 GPIO_ACTIVE_HIGH> //col1 down
        , <&pro_micro 16 GPIO_ACTIVE_HIGH> //col2
        , <&pro_micro 14 GPIO_ACTIVE_HIGH> //col3
        , <&pro_micro 15 GPIO_ACTIVE_HIGH> //col4
        , <&pro_micro 18 GPIO_ACTIVE_HIGH> //col5
        ;
};
